## package/aria2/Config.in
```kconfig
config BR2_PACKAGE_ARIA2
	bool "aria2"
	select BR2_PACKAGE_OPENSSL
	select BR2_PACKAGE_ZLIB
	select BR2_PACKAGE_LIBXML2
	select BR2_PACKAGE_C_ARES
```

## package/obconf/Config.in
```kconfig
config BR2_PACKAGE_OBCONF
	bool "obconf"
	depends on BR2_PACKAGE_LIBGTK2
	depends on BR2_PACKAGE_LIBGLADE
	depends on BR2_PACKAGE_OPENBOX
```

## package/python-bbb-gpio/Config.in
```kconfig
config BR2_PACKAGE_PYTHON_BBB_GPIO
	bool "python-bbb-gpio"
	depends on BR2_arm
	help
	  A Python module to control the GPIO on a Beaglebone Black.

	  https://pypi.org/project/Adafruit_BBIO/
```

## package/rtl8192cu/Config.in
```kconfig
comment "rtl8192cu needs a Linux kernel to be built"
	depends on !BR2_LINUX_KERNEL

config BR2_PACKAGE_RTL8192CU
	bool "rtl8192cu"
	depends on BR2_LINUX_KERNEL
	help
	  rtl8192cu wifi driver
```

## package/tint2/Config.in
```kconfig
config BR2_PACKAGE_TINT2
	bool "tint2"
	depends on BR2_PACKAGE_XORG7
	depends on BR2_PACKAGE_XLIB_LIBX11
	depends on BR2_PACKAGE_XLIB_LIBXCOMPOSITE
	depends on BR2_PACKAGE_XLIB_LIBXDAMAGE
	depends on BR2_PACKAGE_XLIB_LIBXINERAMA
	depends on BR2_PACKAGE_XLIB_LIBXEXT
	depends on BR2_PACKAGE_XLIB_LIBXRENDER
	depends on BR2_PACKAGE_XLIB_LIBXRANDR
	depends on BR2_PACKAGE_PANGO
	depends on BR2_PACKAGE_CAIRO
	depends on BR2_PACKAGE_LIBGLIB2
	depends on BR2_PACKAGE_IMLIB2
	depends on BR2_PACKAGE_LIBRSVG
	depends on BR2_PACKAGE_STARTUP_NOTIFICATION
```
